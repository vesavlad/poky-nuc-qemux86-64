## build/conf/bblayers.conf
```bitbake
# POKY_BBLAYERS_CONF_VERSION is increased each time build/conf/bblayers.conf
# changes incompatibly
POKY_BBLAYERS_CONF_VERSION = "2"

BBPATH = "${TOPDIR}"
BBFILES ?= ""

BBLAYERS ?= " \
  /build/poky/meta \
  /build/poky/meta-poky \
  /build/poky/meta-yocto-bsp \
  /build/poky/meta-ivi/meta-ivi \
  /build/poky/meta-openembedded/meta-oe \
  /build/poky/meta-openembedded/meta-multimedia \
  "
```
